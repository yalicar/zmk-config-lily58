
/ {
  /* Override/define encoder pins for the RIGHT half */
};

/* This works in most Lily58 ZMK shield setups */
&right_encoder {
  a-gpios = <&gpio0 31 (GPIO_PULL_UP | GPIO_ACTIVE_LOW)>;
  b-gpios = <&gpio0 29 (GPIO_PULL_UP | GPIO_ACTIVE_LOW)>;
};
