## config/west.yml
```yaml
manifest:
  remotes:
    - name: zmkfirmware
      url-base: https://github.com/zmkfirmware
    - name: ftc
      url-base: https://github.com/ftc
    - name: mctechnology17
      url-base: https://github.com/mctechnology17

  projects:
    - name: zmk
      remote: ftc
      revision: mouse-ftc
      import: app/west.yml

    - name: zmk-nice-oled
      remote: mctechnology17
      revision: main

  self:
    path: config
```
